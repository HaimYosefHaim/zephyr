/*
 * Copyright (c) 2021 Sateesh Kotapati
 *
 * SPDX-License-Identifier: Apache-2.0
 */

#include <mem.h>
#include <silabs/efm32pg22.dtsi>

/ {
	soc {
		compatible = "silabs,efm32pg22c200f512im40", "silabs,efm32pg22",
						   "silabs,efm32", "simple-bus";
	};
};

&sram0 {
	reg = <0x20000000 DT_SIZE_K(32)>;
};

&flash0 {
	reg = <0 DT_SIZE_K(512)>;
};
