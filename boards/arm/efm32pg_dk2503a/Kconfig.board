## boards/arm/efm32pg_dk2503a/Kconfig.board
```kconfig
# EFM32PG DK2503A board

# Copyright (c) 2018, Christian Taedcke
# Copyright (c) 2019  Lemonbeat GmbH
# SPDX-License-Identifier: Apache-2.0

config BOARD_EFM32PG_DK2503A
	bool "SiLabs EFM32PG-DK2503A (Pearl Gecko)"
	depends on SOC_SERIES_EFM32PG22
	select SOC_PART_NUMBER_EFM32PG22C200F512IM40
```

## boards/arm/efm32pg_dk2503a/Kconfig.defconfig
```kconfig
# EFM32PG DK2503A board

# Copyright (c) 2018, Christian Taedcke
# Copyright (c) 2019  Lemonbeat GmbH
# SPDX-License-Identifier: Apache-2.0

if BOARD_EFM32PG_DK2503A

config BOARD
	default "efm32pg_dk2503a"

config CMU_HFXO_FREQ
	default 38400000

config CMU_LFXO_FREQ
	default 32768

endif # BOARD_EFM32PG_DK2503A
```

## boards/arm/efm32pg_dk2503a/efm32pg_dk2503a_defconfig
```kconfig
# SPDX-License-Identifier: Apache-2.0

CONFIG_ARM_MPU=y
CONFIG_SOC_SERIES_EFM32PG22=y
CONFIG_BOARD_EFM32PG_DK2503A=y
CONFIG_CONSOLE=y
CONFIG_UART_CONSOLE=y
CONFIG_SERIAL=y
CONFIG_CORTEX_M_SYSTICK=y
CONFIG_GPIO=y
CONFIG_SYS_CLOCK_HW_CYCLES_PER_SEC=38400000
CONFIG_CMU_HFCLK_HFXO=y
CONFIG_SOC_GECKO_EMU_DCDC=y
CONFIG_SOC_GECKO_EMU_DCDC_MODE_ON=y
CONFIG_HW_STACK_PROTECTION=y
CONFIG_PINCTRL=y

CONFIG_NO_OPTIMIZATIONS=y
CONFIG_BOOT_BANNER=n
```

## soc/arm/silabs_exx32/efm32pg22/Kconfig.defconfig.series
```kconfig
# EFM32PG1B series configuration options

# Copyright (c) 2020 Rafael Dias Menezes <rdmeneze@gmail.com>
# SPDX-License-Identifier: Apache-2.0

if SOC_SERIES_EFM32PG22

config SOC_SERIES
	default "efm32pg22"

config SOC_PART_NUMBER
	default "EFM32PG22C200F512IM40" if SOC_PART_NUMBER_EFM32PG22C200F512IM40

config NUM_IRQS
	# must be >= the highest interrupt number used
	default 63

endif # SOC_SERIES_EFM32PG22
```

## soc/arm/silabs_exx32/efm32pg22/Kconfig.series
```kconfig
# EFM32PG1B MCU line

# Copyright (c) 2020 Rafael Dias Menezes
# SPDX-License-Identifier: Apache-2.0

config SOC_SERIES_EFM32PG22
	bool "EFM32PG22 Series MCU"
	select ARM
	select ARMV8_M_DSP
	select ARM_TRUSTZONE_M
	select CPU_CORTEX_M33
	select CPU_HAS_ARM_MPU
	select CPU_HAS_ARM_SAU
	select CPU_HAS_FPU
	select HAS_SILABS_GECKO
	select HAS_SWO
	select SOC_FAMILY_EXX32
	select SOC_GECKO_CMU
	select SOC_GECKO_CORE
	select SOC_GECKO_EMU
	select SOC_GECKO_GPIO
	help
	  Enable support for EFM32PG22 PearlGecko MCU series
```

## soc/arm/silabs_exx32/efm32pg22/Kconfig.soc
```kconfig
# EFM32PG22 (Pearl Gecko) MCU line

# Copyright (c) 2018 Christian Taedcke
# SPDX-License-Identifier: Apache-2.0

config SOC_PART_NUMBER_EFM32PG22C200F512IM40
	bool
	depends on SOC_SERIES_EFM32PG22
```
